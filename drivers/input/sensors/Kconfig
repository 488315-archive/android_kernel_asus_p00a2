## drivers/input/sensors/Kconfig
```kconfig
#
# Sensor drivers configuration
#
config SENSORS_AP3425H
        bool "AP3425H Proximity & Light Sensor"
        depends on I2C

config SENSORS_BMC156
        bool "BMC156 G-sensor & E-compass"
        depends on I2C

config HALL_SENSOR
       bool "Hall sensor"
       default n
```

## drivers/input/touchscreen/ft5726/Kconfig
```kconfig
#
# FOCAL FT5726 Touchscreen driver
#

config TOUCHSCREEN_FT5726
	boolean "FOCAL FT5726 touchpanel driver"
	depends on I2C
	default n
	help
	  This is the main file for touchpanel driver for FOCAL FT5726
	  touchscreens.

	  Say Y here if you have a FOCAL FT5726 touchscreen connected
	  to your system.

	  If unsure, say N.
```

## drivers/input/touchscreen/mediatek/gt6108/Kconfig
```kconfig
#
# Goodix GT6108 Touchscreen driver
#

config TOUCHSCREEN_GT6108
	boolean "Goodix GT6108 touchpanel driver"
	depends on I2C
	default n
	help
	  This is the main file for touchpanel driver for Goodix GT6108
	  touchscreens.

	  Say Y here if you have a Goodix GT6108 touchscreen connected
	  to your system.

	  If unsure, say N.
```

## drivers/misc/mediatek/accelerometer/bma2x2/Kconfig
```kconfig
config MTK_BMA2X2
	bool "MTK_BMA2X2 for MediaTek package"
	default n
	help
	  It support different accelerometer sensor.
          If this option is set,
	  it will support
          MTK_BMA2X2 Accelerometer.

config SENSORS_BMA2X2_ENABLE_INT1
	tristate "BMA2X2 acceleration sensor interrupt INT1 support"
	depends on MTK_BMA2X2
	help
	 If you say yes here, you get INT1 support for Bosch Sensortec
	 acceleration sensors BMA255/BMA250E/BMA222E/BMA280.
	 Select it will disable interrupt INT2 support

config SENSORS_BMA2X2_ENABLE_INT2
	tristate "BMA2X2 acceleration sensor interrupt INT2 support"
	depends on MTK_BMA2X2
	help
	 If you say yes here, you get INT2 support for Bosch Sensortec
	 acceleration sensors BMA255/BMA250E/BMA222E/BMA280.
	 Can only open if you do NOT open interrupt INT1 support
```

## drivers/misc/mediatek/accelerometer/bmc156_acc/Kconfig
```kconfig
config MTK_BMC156_ACC
	bool "MTK_BMC156_ACC for MediaTek package"
	default n
	help
	  It support different accelerometer sensor.
          If this option is set,
	  it will support
          MTK_BMC156_ACC Accelerometer.

config BMC156_LOWPASS
	bool "BMC156_LOWPASS for Mediatek package"
	default n
	help
	Say Y here if you have BMC156_LOWPASS.

	If unsure, say N.

	To compile this dirver as a module, choose M here: the
	module will be called.
```

## drivers/misc/mediatek/alsps/als3320a/Kconfig
```kconfig
config MTK_ALS3320A
	bool "als3320a for MediaTek package"
	default n
	help
	It support different type sensor in this platform. 
	If this option is set, it will support ambient and light sensor ALS3320A.
```

## drivers/misc/mediatek/alsps/ap3425h/Kconfig
```kconfig
config MTK_AP3425H
	bool "ap3425h for MediaTek package"
	default n
	help
	It support different type sensor in this platform. 
	If this option is set, it will support ambient and light sensor AP3425H.
```

## drivers/misc/mediatek/magnetometer/bmc156_mag/Kconfig
```kconfig
config MTK_BMC156_MAG
	bool "MTK_BMC156_MAG for MediaTek package"
	default n
	help
	  It support different magnetometer sensor.
          If this option is set,
	  it will support
          BMC156_MAG magnetometer.
```

## drivers/misc/mediatek/magnetometer/bmm050/Kconfig
```kconfig
#
# Makefile for Bosch sensors driver.
#
config BOSCH_DRIVER_LOG_FUNC
	tristate "Bosch Sensortec driver smart log function support"
	depends on (I2C || SPI_MASTER) && SYSFS
	help
	 If you say yes here, you get support for smart log function in Bosch Sensortec driver.

config MTK_BMM050
	tristate "BMM050 Magnetic Sensor Driver"
	depends on I2C
	help
	 If you say yes here, you get support for Bosch Sensortec's
	 sensor BMM050 Magnetic Sensor
```
