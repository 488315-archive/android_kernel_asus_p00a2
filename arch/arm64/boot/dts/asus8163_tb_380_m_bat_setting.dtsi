/*************************
 * Customized Battery Setting dtsi file
*************************/
&bat_comm {
	/* cust_charging.h */
	/* stop charging while in talking mode */
	stop_charging_in_takling = <1>;
	talking_recharge_voltage = <3800>;
	talking_sync_time = <60>;

	/* Battery Temperature Protection */
	mtk_temperature_recharge_support = <1>;
	max_charge_temperature = <50>;
	max_charge_temperature_minus_x_degree = <47>;
	min_charge_temperature = <0>;
	min_charge_temperature_plus_x_degree = <6>;
	err_charge_temperature = <0xff>;

	/* Linear Charging Threshold */
	v_pre2cc_thres = <3400>;	/* unit: mV */
	v_cc2topoff_thres = <4050>;
	recharging_voltage = <4110>;
	charging_full_current = <100>;	/* unit: mA */

	/* Charging Current Setting */
	config_usb_if = <0>;
	usb_charger_current_suspend = <0>;	/* Unit: 0.01 mA */
	usb_charger_current_unconfigured = <7000>;	/* Unit: 0.01 mA */
	usb_charger_current_configured = <50000>;	/* Unit: 0.01 mA */
	usb_charger_current = <50000>;	/* Unit: 0.01 mA */
	ac_charger_current = <200000>;	/* Unit: 0.01 mA */
	non_std_ac_charger_current = <50000>;	/* Unit: 0.01 mA */
	charging_host_charger_current = <65000>;	/* Unit: 0.01 mA */
	apple_0_5a_charger_current = <50000>;	/* Unit: 0.01 mA */
	apple_1_0a_charger_current = <65000>;	/* Unit: 0.01 mA */
	apple_2_1a_charger_current = <80000>;	/* Unit: 0.01 mA */

	/* charger error check */
	bat_low_temp_protect_enable = <0>;
	v_charger_enable = <0>;	/* 1:on , 0:off */
	v_charger_max = <6500>;	/* unit: mV */
	v_charger_min = <4400>;

	/*  Tracking TIME */
	onehundred_percent_tracking_time = <10>;	/* Unit: second */
	npercent_tracking_time = <20>;	/* Unit: second */
	sync_to_real_tracking_time = <60>;	/* Unit: second */
	v_0percent_tracking = <3450>;	/* Unit: mV */

	/* High battery support */
	high_battery_voltage_support = <1>;
};

&bat_meter {
	/* cust_battery_meter.h */
	/* ADC resistor  */
	r_bat_sense = <4>;
	r_i_sense = <4>;
	r_charger_1 = <330>;
	r_charger_2 = <39>;
	temperature_t0 = <110>;
	temperature_t1 = <0>;
	temperature_t2 = <25>;
	temperature_t3 = <50>;
	temperature_t = <255>;	/* this should be fixed, never change the value */
	fg_meter_resistance = <0>;

	/* Qmax for 0mA */
	q_max_pos_50 = <3895>;/*<3009>;*/
	q_max_pos_25 = <3802>;/*<3009>;*/
	q_max_pos_0 = <3309>;/*<3009>;*/
	q_max_neg_10 = <2695>;/*<3009>;*/
	/* Qmax for 400mA, said high current */
	q_max_pos_50_h_current = <2875>;/*<2975>;*/
	q_max_pos_25_h_current = <3766>;/*<2975>;*/
	q_max_pos_0_h_current = <2917>;/*<2975>;*/
	q_max_neg_10_h_current = <1380>;/*<2975>;*/
	/* Discharge percentage, 1: D5, 0: D2 */
	oam_d5 = <0>;

	change_tracking_point = <1>;
	/* SW OCV tracking setting */
	cust_tracking_point = <14>;
	cust_r_sense = <200>;
	cust_hw_cc = <0>;
	aging_tuning_value = <100>;
	cust_r_fg_offset = <0>;
	ocv_board_compesate = <0>;
	r_fg_board_base = <1000>;
	r_fg_board_slope = <1000>;
	car_tune_value = <89>;

	/* HW Fuel gague  */
	current_detect_r_fg = <10>;	/* Unit: mA */
	minerroroffset = <1000>;
	fg_vbat_average_size = <18>;
	r_fg_value = <0>;	/* Unit: mOhm */

	cust_poweron_delta_capacity_tolrance = <80>;
	cust_poweron_low_capacity_tolrance = <2>;
	cust_poweron_max_vbat_tolrance = <70>;
	cust_poweron_delta_vbat_tolrance = <60>;
	cust_poweron_delta_hw_sw_ocv_capacity_tolrance = <10>;

	/* Fixed battery temperature */
	fixed_tbat_25 = <0>;
	/* Dynamic change wake up period of battery thread when suspend */
	vbat_normal_wakeup = <3600>;	/* Unit: mV */
	vbat_low_power_wakeup = <3500>;	/* Unit: mV */
	normal_wakeup_period = <5400>;	/* Unit: second */
	low_power_wakeup_period = <300>;	/* Unit: second */
	close_poweroff_wakeup_period = <30>;	/* Unit: second */

	rbat_pull_up_r = <16900>;
	rbat_pull_up_volt = <1800>;

	batt_temperature_table_num = <17>;
	batt_temperature_table = <
			    (-20) 75022
			    (-15) 57926
			    (-10) 45168
			    (-5) 35548
			    0 28224
			    5 22595
			    10 18231
			    15 14820
			    20 12133
			    25 10000 30 8295 35 6922 40 5810 45 4903 50 4160 55 3547 60 3039>;
	/* t0 -10C */
	battery_profile_t0_num = <104>;
	battery_profile_t0 = <0 4227
				3 4210
				6 4196
				9 4183
				12 4168
				14 4147
				17 4114
				20 4087
				23 4071
				26 4058
				29 4044
				32 4030
				35 4015
				37 4001
				40 3987
				43 3974
				46 3962
				49 3951
				52 3940
				55 3931
				58 3923
				60 3915
				63 3908
				66 3901
				69 3895
				72 3889
				75 3882
				78 3876
				81 3870
				83 3864
				86 3858
				89 3852
				92 3846
				95 3840
				98 3834
				100 3829
				100 3823
				100 3817
				100 3810
				100 3804
				100 3799
				100 3793
				100 3787
				100 3782
				100 3776
				100 3771
				100 3766
				100 3762
				100 3757
				100 3752
				100 3748
				100 3743
				100 3738
				100 3732
				100 3726
				100 3719
				100 3711
				100 3703
				100 3696
				100 3688
				100 3680
				100 3671
				100 3661
				100 3648
				100 3630
				100 3604
				100 3561
				100 3495
				100 3390
				100 3176
				100 3176
				100 3176
				100 3176
				100 3176
				100 3176
				100 3176
				100 3176
				100 3176
				100 3176
				100 3176
				100 3176
				100 3176
				100 3176
				100 3176
				100 3176
				100 3176
				100 3176
				100 3176
				100 3176
				100 3176
				100 3176
				100 3176
				100 3176
				100 3176
				100 3176
				100 3176
				100 3176
				100 3176
				100 3176
				100 3176
				100 3176
				100 3176
				100 3176
				100 3176>;

	battery_profile_t1_num = <104>;
	battery_profile_t1 = <0 4301
				1 4288
				3 4276
				4 4264
				5 4253
				7 4241
				8 4229
				9 4216
				11 4198
				12 4172
				14 4143
				15 4121
				16 4106
				18 4094
				19 4085
				20 4075
				22 4065
				23 4053
				24 4041
				26 4028
				27 4016
				28 4005
				30 3993
				31 3982
				32 3971
				34 3960
				35 3949
				37 3938
				38 3928
				39 3919
				41 3911
				42 3903
				43 3896
				45 3890
				46 3883
				47 3877
				49 3871
				50 3865
				51 3860
				53 3855
				54 3850
				55 3845
				57 3840
				58 3836
				60 3831
				61 3827
				62 3823
				64 3818
				65 3814
				66 3810
				68 3806
				69 3803
				70 3799
				72 3795
				73 3791
				74 3788
				76 3784
				77 3780
				78 3777
				80 3773
				81 3770
				83 3766
				84 3762
				85 3757
				87 3753
				88 3747
				89 3741
				91 3734
				92 3727
				93 3720
				95 3713
				96 3708
				97 3704
				99 3701
				100 3699
				100 3696
				100 3693
				100 3690
				100 3684
				100 3675
				100 3656
				100 3620
				100 3566
				100 3492
				100 3384
				100 3183
				100 3183
				100 3183
				100 3183
				100 3183
				100 3183
				100 3183
				100 3183
				100 3183
				100 3183
				100 3183
				100 3183
				100 3183
				100 3183
				100 3183
				100 3183
				100 3183
				100 3183
				100 3183>;

	battery_profile_t2_num = <104>;
	battery_profile_t2 = < 0 4295
				 1 4282
				 2 4270
				 3 4259
				 4 4248
				 5 4236
				 6 4225
				 7 4214
				 8 4204
				 9 4193
				 10 4182
				 11 4172
				 12 4161
				 13 4151
				 14 4140
				 15 4130
				 16 4120
				 17 4110
				 19 4100
				 20 4090
				 21 4081
				 22 4074
				 23 4065
				 24 4054
				 25 4044
				 26 4034
				 27 4024
				 28 4014
				 29 4005
				 30 3997
				 31 3989
				 32 3981
				 33 3974
				 34 3967
				 35 3961
				 36 3953
				 37 3945
				 38 3937
				 39 3926
				 40 3914
				 41 3900
				 42 3888
				 43 3878
				 44 3871
				 45 3864
				 46 3859
				 47 3853
				 48 3848
				 49 3843
				 50 3839
				 51 3834
				 53 3830
				 54 3826
				 55 3822
				 56 3818
				 57 3814
				 58 3810
				 59 3807
				 60 3804
				 61 3800
				 62 3797
				 63 3794
				 64 3791
				 65 3789
				 66 3786
				 67 3784
				 68 3781
				 69 3779
				 70 3776
				 71 3773
				 72 3770
				 73 3767
				 74 3764
				 75 3761
				 76 3756
				 77 3753
				 78 3747
				 79 3744
				 80 3740
				 81 3734
				 82 3727
				 83 3718
				 84 3710
				 85 3700
				 86 3690
				 87 3688
				 89 3686
				 90 3685
				 91 3684
				 92 3683
				 93 3682
				 94 3679
				 95 3674
				 96 3656
				 97 3618
				 98 3569
				 99 3505
				 100 3420
				 100 3295
				 100 3058
				 100 3058
				 100 3058
				 100 3058
				 100 3058>;

	battery_profile_t3_num = <104>;
	battery_profile_t3 = <0 4320
				1 4307
				2 4296
				3 4284
				4 4273
				5 4261
				6 4250
				7 4239
				8 4228
				9 4217
				10 4206
				11 4195
				12 4184
				13 4174
				14 4163
				15 4153
				16 4142
				17 4132
				18 4122
				19 4111
				20 4101
				21 4092
				22 4082
				23 4072
				24 4063
				25 4054
				26 4045
				27 4035
				28 4026
				29 4017
				30 4008
				31 4000
				32 3992
				33 3984
				34 3976
				35 3969
				36 3961
				37 3954
				38 3947
				39 3940
				40 3932
				41 3923
				42 3911
				43 3895
				45 3883
				46 3874
				47 3867
				48 3861
				49 3855
				50 3850
				51 3845
				52 3840
				53 3835
				54 3831
				55 3826
				56 3822
				57 3818
				58 3814
				59 3810
				60 3807
				61 3803
				62 3800
				63 3797
				64 3794
				65 3791
				66 3788
				67 3785
				68 3782
				69 3780
				70 3776
				71 3770
				72 3762
				73 3756
				74 3753
				75 3749
				76 3746
				77 3742
				78 3738
				79 3734
				80 3730
				81 3726
				82 3722
				83 3716
				84 3707
				85 3699
				86 3690
				87 3679
				88 3674
				89 3673
				90 3672
				91 3671
				92 3669
				93 3668
				94 3666
				95 3661
				96 3646
				97 3613
				98 3568
				99 3512
				100 3438
				100 3330
				100 3150
				100 2824
				100 2824>;

	r_profile_t0_num = <104>;
        r_profile_t0 = <562 4227
				562 4210
				580 4196
				590 4183
				605 4168
				638 4147
				747 4114
				878 4087
				934 4071
				957 4058
				965 4044
				975 4030
				980 4015
				987 4001
				992 3987
				995 3974
				997 3962
				1003 3951
				1003 3940
				1005 3931
				1010 3923
				1013 3915
				1018 3908
				1023 3901
				1030 3895
				1035 3889
				1038 3882
				1046 3876
				1051 3870
				1056 3864
				1063 3858
				1068 3852
				1073 3846
				1078 3840
				1084 3834
				1091 3829
				1099 3823
				1104 3817
				1106 3810
				1111 3804
				1119 3799
				1127 3793
				1132 3787
				1139 3782
				1144 3776
				1152 3771
				1162 3766
				1172 3762
				1182 3757
				1195 3752
				1210 3748
				1225 3743
				1246 3738
				1261 3732
				1284 3726
				1301 3719
				1319 3711
				1339 3703
				1359 3696
				1380 3688
				1403 3680
				1423 3671
				1443 3661
				1461 3648
				1481 3630
				1504 3604
				1519 3561
				1542 3495
				1590 3390
				1881 3176
				2005 3176
				2005 3176
				2005 3176
				2005 3176
				2005 3176
				2005 3176
				2005 3176
				2005 3176
				2005 3176
				2005 3176
				2005 3176
				2005 3176
				2005 3176
				2005 3176
				2005 3176
				2005 3176
				2005 3176
				2005 3176
				2005 3176
				2005 3176
				2005 3176
				2005 3176
				2005 3176
				2005 3176
				2005 3176
				2005 3176
				2005 3176
				2005 3176
				2005 3176
				2005 3176
				2005 3176
				2005 3176
				2005 3176
				2005 3176>;

	r_profile_t1_num = <104>;
        r_profile_t1 = <225 4301
				225 4288
				233 4276
				235 4264
				241 4253
				243 4241		
				251 4229
				258 4216
				266 4198
				284 4172
				347 4143
				410 4121
				443 4106
				456 4094
				463 4085
				471 4075
				476 4065
				484 4053
				489 4041
				491 4028
				496 4016
				501 4005
				501 3993
				504 3982
				504 3971
				504 3960
				504 3949
				501 3938
				499 3928
				499 3919
				501 3911
				501 3903
				504 3896
				509 3890
				509 3883
				514 3877
				516 3871
				519 3865
				524 3860
				529 3855
				532 3850
				537 3845
				539 3840
				544 3836
				547 3831
				552 3827
				557 3823
				559 3818
				565 3814
				567 3810
				572 3806
				577 3803
				582 3799
				585 3795
				587 3791
				595 3788
				597 3784
				600 3780
				605 3777
				610 3773
				620 3770
				628 3766
				638 3762
				648 3757
				658 3753
				668 3747
				676 3741
				684 3734
				694 3727
				701 3720
				706 3713
				716 3708
				729 3704
				742 3701
				759 3699
				775 3696
				792 3693
				813 3690
				828 3684
				843 3675
				853 3656
				853 3620
				863 3566
				889 3492
				929 3384
				1106 3183
				2030 3183
				2030 3183
				2030 3183
				2030 3183
				2030 3183
				2030 3183
				2030 3183
				2030 3183
				2030 3183
				2030 3183
				2030 3183
				2030 3183
				2030 3183
				2030 3183
				2030 3183
				2030 3183
				2030 3183
				2030 3183>;

	r_profile_t2_num = <104>;
        r_profile_t2 = <124 4295
				124 4282
				124 4270
				127 4259
				129 4248
				127 4236
				127 4225
				127 4214
				129 4204
				129 4193
				129 4182
				132 4172
				132 4161
				134 4151
				132 4140
				134 4130
				134 4120
				137 4110
				137 4100
				137 4090
				139 4081
				142 4074
				144 4065
				142 4054
				144 4044
				147 4034
				149 4024
				149 4014
				152 4005
				154 3997
				157 3989
				159 3981
				162 3974
				165 3967
				167 3961
				170 3953
				170 3945
				172 3937
				167 3926
				162 3914
				149 3900
				142 3888
				134 3878
				134 3871
				132 3864
				134 3859
				134 3853
				134 3848
				134 3843
				137 3839
				137 3834
				137 3830
				139 3826
				139 3822
				139 3818
				142 3814
				142 3810
				142 3807
				144 3804
				144 3800
				144 3797
				144 3794
				144 3791
				147 3789
				147 3786
				149 3784
				149 3781
				149 3779
				149 3776
				147 3773
				147 3770
				147 3767
				147 3764
				149 3761
				147 3756
				152 3753
				147 3747
				152 3744
				154 3740
				157 3734
				157 3727
				157 3718
				159 3710
				162 3700
				157 3690
				159 3688
				159 3686
				162 3685
				167 3684
				175 3683
				182 3682
				187 3679
				195 3674
				190 3656
				190 3618
				200 3569
				210 3505
				230 3420
				278 3295
				716 3058
				1734 3058
				1734 3058
				1734 3058
				1734 3058>;

	r_profile_t3_num = <104>;
        r_profile_t3 = <86 4320
				86 4307
				89 4296
				89 4284
				89 4273
				89 4261
				89 4250
				89 4239
				89 4228
				89 4217
				89 4206
				89 4195
				89 4184
				91 4174
				91 4163
				94 4153
				91 4142
				94 4132
				94 4122
				94 4111
				94 4101
				96 4092
				96 4082
				96 4072
				99 4063
				99 4054
				99 4045
				99 4035
				101 4026
				101 4017
				101 4008
				104 4000
				104 3992
				104 3984
				106 3976
				109 3969
				109 3961
				111 3954
				114 3947
				116 3940
				119 3932
				119 3923
				114 3911
				101 3895
				94 3883
				91 3874
				91 3867
				91 3861
				89 3855
				91 3850
				91 3845
				91 3840
				91 3835
				94 3831
				91 3826
				94 3822
				94 3818
				96 3814
				96 3810
				99 3807
				99 3803
				99 3800
				101 3797
				101 3794
				104 3791
				104 3788
				104 3785
				104 3782
				104 3780
				101 3776
				96 3770
				94 3762
				94 3756
				96 3753
				94 3749
				96 3746
				96 3742
				96 3738
				96 3734
				96 3730
				96 3726
				99 3722
				99 3716
				96 3707
				96 3699
				96 3690
				96 3679
				94 3674
				96 3673
				99 3672
				101 3671
				101 3669
				104 3668
				106 3666
				106 3661
				104 3646
				106 3613
				109 3568
				116 3512
				124 3438
				134 3330
				223 3150
				987 2824
				1149 2824>;

};
