/*************************
 * Customized Battery Setting dtsi file
*************************/
&bat_comm_1 {
	/* cust_charging.h */
	/* stop charging while in talking mode */
	stop_charging_in_takling = <1>;
	talking_recharge_voltage = <3800>;
	talking_sync_time = <60>;

	/* Battery Temperature Protection */
	mtk_temperature_recharge_support = <1>;
	max_charge_temperature = <50>;
	max_charge_temperature_minus_x_degree = <47>;
	min_charge_temperature = <0>;
	min_charge_temperature_plus_x_degree = <6>;
	err_charge_temperature = <0xff>;

	/* Linear Charging Threshold */
	v_pre2cc_thres = <3400>;	/* unit: mV */
	v_cc2topoff_thres = <4050>;
	recharging_voltage = <4110>;
	charging_full_current = <100>;	/* unit: mA */

	/* Charging Current Setting */
	config_usb_if = <0>;
	usb_charger_current_suspend = <0>;	/* Unit: 0.01 mA */
	usb_charger_current_unconfigured = <7000>;	/* Unit: 0.01 mA */
	usb_charger_current_configured = <50000>;	/* Unit: 0.01 mA */
	usb_charger_current = <50000>;	/* Unit: 0.01 mA */
	ac_charger_current = <200000>;	/* Unit: 0.01 mA */
	non_std_ac_charger_current = <50000>;	/* Unit: 0.01 mA */
	charging_host_charger_current = <65000>;	/* Unit: 0.01 mA */
	apple_0_5a_charger_current = <50000>;	/* Unit: 0.01 mA */
	apple_1_0a_charger_current = <65000>;	/* Unit: 0.01 mA */
	apple_2_1a_charger_current = <80000>;	/* Unit: 0.01 mA */

	/* charger error check */
	bat_low_temp_protect_enable = <0>;
	v_charger_enable = <0>;	/* 1:on , 0:off */
	v_charger_max = <6500>;	/* unit: mV */
	v_charger_min = <4400>;

	/*  Tracking TIME */
	onehundred_percent_tracking_time = <10>;	/* Unit: second */
	npercent_tracking_time = <20>;	/* Unit: second */
	sync_to_real_tracking_time = <60>;	/* Unit: second */
	v_0percent_tracking = <3450>;	/* Unit: mV */

	/* High battery support */
	high_battery_voltage_support = <1>;
};

&bat_meter_1 {
	/* cust_battery_meter.h */
	/* ADC resistor  */
	r_bat_sense = <4>;
	r_i_sense = <4>;
	r_charger_1 = <330>;
	r_charger_2 = <39>;
	temperature_t0 = <110>;
	temperature_t1 = <0>;
	temperature_t2 = <25>;
	temperature_t3 = <50>;
	temperature_t = <255>;	/* this should be fixed, never change the value */
	fg_meter_resistance = <0>;

	/* Qmax for 0mA */
	q_max_pos_50 = <3892>;/*<3009>;*/
	q_max_pos_25 = <3780>;/*<3009>;*/
	q_max_pos_0 = <3270>;/*<3009>;*/
	q_max_neg_10 = <2625>;/*<3009>;*/
	/* Qmax for 400mA, said high current */
	q_max_pos_50_h_current = <3853>;/*<2975>;*/
	q_max_pos_25_h_current = <3722>;/*<2975>;*/
	q_max_pos_0_h_current = <2819>;/*<2975>;*/
	q_max_neg_10_h_current = <1390>;/*<2975>;*/
	/* Discharge percentage, 1: D5, 0: D2 */
	oam_d5 = <0>;

	change_tracking_point = <1>;
	/* SW OCV tracking setting */
	cust_tracking_point = <14>;
	cust_r_sense = <200>;
	cust_hw_cc = <0>;
	aging_tuning_value = <100>;
	cust_r_fg_offset = <0>;
	ocv_board_compesate = <0>;
	r_fg_board_base = <1000>;
	r_fg_board_slope = <1000>;
	car_tune_value = <89>;

	/* HW Fuel gague  */
	current_detect_r_fg = <10>;	/* Unit: mA */
	minerroroffset = <1000>;
	fg_vbat_average_size = <18>;
	r_fg_value = <0>;	/* Unit: mOhm */

	cust_poweron_delta_capacity_tolrance = <80>;
	cust_poweron_low_capacity_tolrance = <2>;
	cust_poweron_max_vbat_tolrance = <70>;
	cust_poweron_delta_vbat_tolrance = <60>;
	cust_poweron_delta_hw_sw_ocv_capacity_tolrance = <10>;

	/* Fixed battery temperature */
	fixed_tbat_25 = <0>;
	/* Dynamic change wake up period of battery thread when suspend */
	vbat_normal_wakeup = <3600>;	/* Unit: mV */
	vbat_low_power_wakeup = <3500>;	/* Unit: mV */
	normal_wakeup_period = <5400>;	/* Unit: second */
	low_power_wakeup_period = <300>;	/* Unit: second */
	close_poweroff_wakeup_period = <30>;	/* Unit: second */

	rbat_pull_up_r = <16900>;
	rbat_pull_up_volt = <1800>;

	batt_temperature_table_num = <17>;
	batt_temperature_table = <
			    (-20) 75022
			    (-15) 57926
			    (-10) 45168
			    (-5) 35548
			    0 28224
			    5 22595
			    10 18231
			    15 14820
			    20 12133
			    25 10000 30 8295 35 6922 40 5810 45 4903 50 4160 55 3547 60 3039>;
	/* t0 -10C */
	battery_profile_t0_num = <104>;
	battery_profile_t0 = <0 4230 
				1 4209 
				3 4193 
				4 4179 
				6 4169 
				7 4161 
				9 4150 
				10 4131 
				12 4108 
				13 4088 
				15 4071 
				16 4058 
				18 4046 
				19 4035 
				21 4024 
				22 4006 
				24 3967 
				25 3935 
				27 3919 
				28 3907 
				30 3896 
				31 3886 
				33 3877 
				34 3868 
				36 3861 
				37 3853 
				39 3847 
				40 3840 
				42 3834 
				43 3828 
				45 3823 
				46 3818 
				48 3813 
				49 3808 
				51 3803 
				52 3799 
				54 3795 
				55 3792 
				57 3788 
				58 3785 
				60 3783 
				61 3780 
				63 3777 
				64 3774 
				66 3771 
				67 3767 
				69 3763 
				70 3759 
				72 3754 
				73 3748 
				75 3742 
				76 3736 
				78 3729 
				79 3721 
				81 3713 
				82 3705 
				84 3697 
				85 3689 
				87 3681 
				88 3672 
				90 3662 
				91 3650 
				93 3633 
				94 3612 
				96 3581 
				97 3537 
				99 3476 
				100 3392 
				100 3264 
				100 3113 
				100 3113 
				100 3113 
				100 3113 
				100 3113 
				100 3113 
				100 3113 
				100 3113 
				100 3113 
				100 3113 
				100 3113 
				100 3113 
				100 3113 
				100 3113 
				100 3113 
				100 3113 
				100 3113 
				100 3113 
				100 3113 
				100 3113 
				100 3113 
				100 3113 
				100 3113 
				100 3113 
				100 3113 
				100 3113 
				100 3113 
				100 3113 
				100 3113 
				100 3113 
				100 3113 
				100 3113 
				100 3113 
				100 3113 
				100 3113>;

	battery_profile_t1_num = <104>;
	battery_profile_t1 = <0 4280 
				1 4264 
				2 4248 
				4 4234 
				5 4212 
				6 4167 
				7 4138 
				8 4123 
				10 4111 
				11 4099 
				12 4091 
				13 4086 
				14 4075 
				16 4059 
				17 4043 
				18 4023 
				19 4007 
				20 3995 
				22 3985 
				23 3973 
				24 3964 
				25 3956 
				26 3948 
				28 3941 
				29 3933 
				30 3918 
				31 3906 
				32 3897 
				34 3884 
				35 3875 
				36 3869 
				37 3861 
				38 3852 
				40 3846 
				41 3841 
				42 3834 
				43 3828 
				44 3824 
				46 3819 
				47 3814 
				48 3810 
				49 3806 
				50 3802 
				52 3798 
				53 3794 
				54 3791 
				55 3789 
				56 3786 
				58 3785 
				59 3784 
				60 3784 
				61 3783 
				62 3782 
				64 3781 
				65 3780 
				66 3779 
				67 3777 
				68 3776 
				70 3773 
				71 3771 
				72 3768 
				73 3765 
				74 3760 
				76 3757 
				77 3752 
				78 3746 
				79 3739 
				80 3730 
				82 3720 
				83 3707 
				84 3691 
				85 3674 
				86 3655 
				88 3634 
				89 3614 
				90 3597 
				91 3582 
				92 3568 
				94 3556 
				95 3544 
				96 3529 
				97 3510 
				98 3478 
				100 3427 
				100 3358 
				100 3263 
				100 3102 
				100 3102 
				100 3102 
				100 3102 
				100 3102 
				100 3102 
				100 3102 
				100 3102 
				100 3102 
				100 3102 
				100 3102 
				100 3102 
				100 3102 
				100 3102 
				100 3102 
				100 3102 
				100 3102 
				100 3102>;

	battery_profile_t2_num = <104>;
	battery_profile_t2 = <0 4305 
				1 4288 
				2 4275 
				3 4261 
				4 4248 
				5 4236 
				6 4223 
				7 4211 
				8 4200 
				9 4189 
				10 4177 
				11 4165 
				12 4154 
				13 4143 
				14 4131 
				16 4120 
				17 4109 
				18 4099 
				19 4088 
				20 4078 
				21 4072 
				22 4064 
				23 4051 
				24 4037 
				25 4022 
				26 4009 
				27 3998 
				28 3989 
				29 3982 
				30 3977 
				31 3970 
				32 3962 
				33 3953 
				34 3945 
				35 3937 
				36 3929 
				37 3921 
				38 3912 
				39 3903 
				40 3892 
				41 3880 
				43 3868 
				44 3857 
				45 3848 
				46 3840 
				47 3833 
				48 3827 
				49 3821 
				50 3816 
				51 3811 
				52 3806 
				53 3802 
				54 3798 
				55 3794 
				56 3791 
				57 3788 
				58 3785 
				59 3783 
				60 3781 
				61 3779 
				62 3778 
				63 3778 
				64 3778 
				65 3778 
				66 3777 
				67 3777 
				68 3777 
				69 3776 
				70 3776 
				71 3774 
				72 3773 
				73 3770 
				74 3767 
				75 3764 
				76 3760 
				77 3757 
				78 3752 
				79 3747 
				80 3739 
				81 3728 
				82 3712 
				83 3695 
				84 3676 
				85 3656 
				86 3637 
				87 3619 
				88 3603 
				89 3588 
				90 3573 
				91 3559 
				92 3549 
				93 3541 
				94 3534 
				95 3527 
				96 3520 
				97 3511 
				98 3498 
				99 3470 
				100 3423 
				100 3364 
				100 3288 
				100 3179 
				100 3179 
				100 3179>;

	battery_profile_t3_num = <104>;
	battery_profile_t3 = <0 4314 
				1 4298 
				2 4284 
				3 4270 
				4 4257 
				5 4244 
				6 4232 
				7 4220 
				8 4208 
				9 4196 
				10 4184 
				11 4173 
				12 4161 
				13 4150 
				14 4139 
				15 4127 
				16 4116 
				17 4105 
				18 4095 
				19 4084 
				20 4073 
				21 4063 
				22 4052 
				23 4042 
				24 4032 
				25 4022 
				26 4012 
				27 4003 
				28 3994 
				29 3984 
				30 3975 
				31 3967 
				32 3958 
				33 3950 
				34 3941 
				35 3933 
				36 3925 
				37 3917 
				38 3909 
				39 3900 
				40 3889 
				41 3878 
				42 3866 
				43 3855 
				44 3846 
				45 3838 
				46 3831 
				47 3825 
				48 3819 
				49 3814 
				50 3809 
				51 3804 
				52 3799 
				53 3795 
				54 3791 
				55 3788 
				56 3784 
				57 3781 
				58 3779 
				59 3776 
				60 3774 
				61 3772 
				62 3771 
				63 3770 
				64 3769 
				65 3769 
				66 3769 
				68 3768 
				69 3768 
				70 3767 
				71 3766 
				72 3762 
				73 3756 
				74 3750 
				75 3746 
				76 3743 
				77 3740 
				78 3736 
				79 3730 
				80 3723 
				81 3714 
				82 3700 
				83 3684 
				84 3666 
				85 3648 
				86 3629 
				87 3612 
				88 3597 
				89 3582 
				90 3568 
				91 3555 
				92 3546 
				93 3539 
				94 3532 
				95 3525 
				96 3518 
				97 3508 
				98 3491 
				99 3455 
				100 3406 
				100 3346 
				100 3265 
				100 3145 
				100 3145>;

	r_profile_t0_num = <104>;
        r_profile_t0 = <489 4230 
				489 4209 
				510 4193 
				520 4179 
				531 4169 
				546 4161 
				555 4150 
				553 4131 
				547 4108 
				544 4088 
				546 4071 
				553 4058 
				561 4046 
				575 4035 
				595 4024 
				630 4006 
				740 3967 
				927 3935 
				975 3919 
				986 3907 
				987 3896 
				986 3886 
				983 3877 
				982 3868 
				984 3861 
				983 3853 
				984 3847 
				986 3840 
				988 3834 
				991 3828 
				992 3823 
				994 3818 
				997 3813 
				1001 3808 
				1003 3803 
				1006 3799 
				1008 3795 
				1012 3792 
				1016 3788 
				1019 3785 
				1025 3783 
				1029 3780 
				1033 3777 
				1039 3774 
				1044 3771 
				1049 3767 
				1055 3763 
				1062 3759 
				1069 3754 
				1078 3748 
				1086 3742 
				1097 3736 
				1108 3729 
				1119 3721 
				1133 3713 
				1146 3705 
				1161 3697 
				1177 3689 
				1195 3681 
				1213 3672 
				1231 3662 
				1251 3650 
				1271 3633 
				1287 3612 
				1306 3581 
				1322 3537 
				1345 3476 
				1383 3392 
				1483 3264 
				1874 3113 
				1874 3113 
				1874 3113 
				1874 3113 
				1874 3113 
				1874 3113 
				1874 3113 
				1874 3113 
				1874 3113 
				1874 3113 
				1874 3113 
				1874 3113 
				1874 3113 
				1874 3113 
				1874 3113 
				1874 3113 
				1874 3113 
				1874 3113 
				1874 3113 
				1874 3113 
				1874 3113 
				1874 3113 
				1874 3113 
				1874 3113 
				1874 3113 
				1874 3113 
				1874 3113 
				1874 3113 
				1874 3113 
				1874 3113 
				1874 3113 
				1874 3113 
				1874 3113 
				1874 3113 
				1874 3113>;

	r_profile_t1_num = <104>;
        r_profile_t1 = <229 4280 
				229 4264 
				233 4248 
				241 4234 
				238 4212 
				248 4167 
				392 4138 
				429 4123 
				434 4111 
				432 4099 
				437 4091 
				451 4086 
				456 4075 
				461 4059 
				469 4043 
				462 4023 
				461 4007 
				462 3995 
				466 3985 
				461 3973 
				466 3964 
				467 3956 
				468 3948 
				469 3941 
				471 3933 
				457 3918 
				451 3906 
				452 3897 
				441 3884 
				440 3875 
				445 3869 
				446 3861 
				440 3852 
				442 3846 
				447 3841 
				445 3834 
				445 3828 
				451 3824 
				452 3819 
				454 3814 
				456 3810 
				458 3806 
				460 3802 
				461 3798 
				463 3794 
				464 3791 
				467 3789 
				469 3786 
				471 3785 
				473 3784 
				475 3784 
				478 3783 
				481 3782 
				482 3781 
				487 3780 
				491 3779 
				493 3777 
				498 3776 
				503 3773 
				508 3771 
				514 3768 
				522 3765 
				527 3760 
				540 3757 
				551 3752 
				565 3746 
				579 3739 
				594 3730 
				610 3720 
				625 3707 
				635 3691 
				644 3674 
				649 3655 
				650 3634 
				650 3614 
				651 3597 
				654 3582 
				659 3568 
				669 3556 
				680 3544 
				694 3529 
				709 3510 
				722 3478 
				738 3427 
				772 3358 
				829 3263 
				989 3102 
				1834 3102 
				1834 3102 
				1834 3102 
				1834 3102 
				1834 3102 
				1834 3102 
				1834 3102 
				1834 3102 
				1834 3102 
				1834 3102 
				1834 3102 
				1834 3102 
				1834 3102 
				1834 3102 
				1834 3102 
				1834 3102 
				1834 3102>;

	r_profile_t2_num = <104>;
        r_profile_t2 = <132 4305 
				132 4288 
				137 4275 
				137 4261 
				137 4248 
				139 4236 
				137 4223 
				139 4211 
				139 4200 
				142 4189 
				142 4177 
				139 4165 
				139 4154 
				142 4143 
				139 4131 
				142 4120 
				142 4109 
				144 4099 
				144 4088 
				144 4078 
				147 4072 
				149 4064 
				150 4051 
				152 4037 
				151 4022 
				151 4009 
				150 3998 
				151 3989 
				152 3982 
				156 3977 
				155 3970 
				155 3962 
				157 3953 
				158 3945 
				160 3937 
				161 3929 
				164 3921 
				165 3912 
				167 3903 
				162 3892 
				157 3880 
				149 3868 
				144 3857 
				142 3848 
				139 3840 
				139 3833 
				139 3827 
				137 3821 
				137 3816 
				137 3811 
				137 3806 
				137 3802 
				137 3798 
				137 3794 
				137 3791 
				137 3788 
				137 3785 
				139 3783 
				139 3781 
				139 3779 
				139 3778 
				139 3778 
				142 3778 
				144 3778 
				142 3777 
				144 3777 
				147 3777 
				147 3776 
				149 3776 
				147 3774 
				149 3773 
				147 3770 
				147 3767 
				149 3764 
				147 3760 
				149 3757 
				149 3752 
				154 3747 
				157 3739 
				159 3728 
				162 3712 
				167 3695 
				167 3676 
				167 3656 
				167 3637 
				167 3619 
				167 3603 
				167 3588 
				165 3573 
				165 3559 
				168 3549 
				168 3541 
				170 3534 
				173 3527 
				177 3520 
				182 3511 
				188 3498 
				189 3470 
				194 3423 
				206 3364 
				226 3288 
				257 3179 
				981 3179 
				981 3179>;

	r_profile_t3_num = <104>;
        r_profile_t3 = <109 4314 
				109 4298 
				111 4284 
				111 4270 
				114 4257 
				111 4244 
				114 4232 
				114 4220 
				114 4208 
				114 4196 
				114 4184 
				116 4173 
				114 4161 
				116 4150 
				116 4139 
				114 4127 
				114 4116 
				114 4105 
				116 4095 
				116 4084 
				116 4073 
				116 4063 
				116 4052 
				116 4042 
				116 4032 
				119 4022 
				119 4012 
				119 4003 
				122 3994 
				119 3984 
				119 3975 
				122 3967 
				122 3958 
				124 3950 
				124 3941 
				127 3933 
				127 3925 
				129 3917 
				132 3909 
				132 3900 
				129 3889 
				127 3878 
				122 3866 
				116 3855 
				116 3846 
				116 3838 
				114 3831 
				116 3825 
				114 3819 
				114 3814 
				114 3809 
				114 3804 
				114 3799 
				114 3795 
				114 3791 
				116 3788 
				114 3784 
				114 3781 
				116 3779 
				114 3776 
				116 3774 
				116 3772 
				116 3771 
				116 3770 
				116 3769 
				119 3769 
				119 3769 
				119 3768 
				122 3768 
				122 3767 
				124 3766 
				119 3762 
				114 3756 
				116 3750 
				116 3746 
				116 3743 
				119 3740 
				119 3736 
				119 3730 
				119 3723 
				122 3714 
				122 3700 
				122 3684 
				119 3666 
				122 3648 
				120 3629 
				120 3612 
				119 3597 
				119 3582 
				119 3568 
				119 3555 
				119 3546 
				120 3539 
				121 3532 
				122 3525 
				124 3518 
				126 3508 
				127 3491 
				126 3455 
				129 3406 
				134 3346 
				138 3265 
				147 3145 
				1096 3145>;

};
