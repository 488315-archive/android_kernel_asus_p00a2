/*************************
 * Customized Battery Setting dtsi file
*************************/
&bat_comm {
	/* cust_charging.h */
	/* stop charging while in talking mode */
	stop_charging_in_takling = <1>;
	talking_recharge_voltage = <3800>;
	talking_sync_time = <60>;

	/* Battery Temperature Protection */
	mtk_temperature_recharge_support = <1>;
	max_charge_temperature = <50>;
	max_charge_temperature_minus_x_degree = <47>;
	min_charge_temperature = <0>;
	min_charge_temperature_plus_x_degree = <6>;
	err_charge_temperature = <0xff>;

	/* Linear Charging Threshold */
	v_pre2cc_thres = <3400>;	/* unit: mV */
	v_cc2topoff_thres = <4050>;
	recharging_voltage = <4110>;
	charging_full_current = <100>;	/* unit: mA */

	/* Charging Current Setting */
	config_usb_if = <0>;
	usb_charger_current_suspend = <0>;	/* Unit: 0.01 mA */
	usb_charger_current_unconfigured = <7000>;	/* Unit: 0.01 mA */
	usb_charger_current_configured = <50000>;	/* Unit: 0.01 mA */
	usb_charger_current = <50000>;	/* Unit: 0.01 mA */
	ac_charger_current = <200000>;	/* Unit: 0.01 mA */
	non_std_ac_charger_current = <50000>;	/* Unit: 0.01 mA */
	charging_host_charger_current = <65000>;	/* Unit: 0.01 mA */
	apple_0_5a_charger_current = <50000>;	/* Unit: 0.01 mA */
	apple_1_0a_charger_current = <65000>;	/* Unit: 0.01 mA */
	apple_2_1a_charger_current = <80000>;	/* Unit: 0.01 mA */

	/* charger error check */
	bat_low_temp_protect_enable = <0>;
	v_charger_enable = <0>;	/* 1:on , 0:off */
	v_charger_max = <6500>;	/* unit: mV */
	v_charger_min = <4400>;

	/*  Tracking TIME */
	onehundred_percent_tracking_time = <10>;	/* Unit: second */
	npercent_tracking_time = <20>;	/* Unit: second */
	sync_to_real_tracking_time = <60>;	/* Unit: second */
	v_0percent_tracking = <3450>;	/* Unit: mV */

	/* High battery support */
	high_battery_voltage_support = <1>;
};

&bat_meter {
	/* cust_battery_meter.h */
	/* ADC resistor  */
	r_bat_sense = <4>;
	r_i_sense = <4>;
	r_charger_1 = <330>;
	r_charger_2 = <39>;
	temperature_t0 = <110>;
	temperature_t1 = <0>;
	temperature_t2 = <25>;
	temperature_t3 = <50>;
	temperature_t = <255>;	/* this should be fixed, never change the value */
	fg_meter_resistance = <0>;

	/* Qmax for 0mA */
	q_max_pos_50 = <4539>;/*<3009>;*/
	q_max_pos_25 = <4558>;/*<3009>;*/
	q_max_pos_0 = <4133>;/*<3009>;*/
	q_max_neg_10 = <4133>;/*<3009>;*/
	/* Qmax for 400mA, said high current */
	q_max_pos_50_h_current = <4517>;/*<2975>;*/
	q_max_pos_25_h_current = <4522>;/*<2975>;*/
	q_max_pos_0_h_current = <3871>;/*<2975>;*/
	q_max_neg_10_h_current = <3871>;/*<2975>;*/
	/* Discharge percentage, 1: D5, 0: D2 */
	oam_d5 = <0>;

	change_tracking_point = <1>;
	/* SW OCV tracking setting */
	cust_tracking_point = <14>;
	cust_r_sense = <200>;
	cust_hw_cc = <0>;
	aging_tuning_value = <100>;
	cust_r_fg_offset = <0>;
	ocv_board_compesate = <0>;
	r_fg_board_base = <1000>;
	r_fg_board_slope = <1000>;
	car_tune_value = <89>;

	/* HW Fuel gague  */
	current_detect_r_fg = <10>;	/* Unit: mA */
	minerroroffset = <1000>;
	fg_vbat_average_size = <18>;
	r_fg_value = <0>;	/* Unit: mOhm */

	cust_poweron_delta_capacity_tolrance = <80>;
	cust_poweron_low_capacity_tolrance = <2>;
	cust_poweron_max_vbat_tolrance = <70>;
	cust_poweron_delta_vbat_tolrance = <60>;
	cust_poweron_delta_hw_sw_ocv_capacity_tolrance = <10>;

	/* Fixed battery temperature */
	fixed_tbat_25 = <0>;
	/* Dynamic change wake up period of battery thread when suspend */
	vbat_normal_wakeup = <3600>;	/* Unit: mV */
	vbat_low_power_wakeup = <3500>;	/* Unit: mV */
	normal_wakeup_period = <5400>;	/* Unit: second */
	low_power_wakeup_period = <300>;	/* Unit: second */
	close_poweroff_wakeup_period = <30>;	/* Unit: second */

	rbat_pull_up_r = <16900>;
	rbat_pull_up_volt = <1800>;

	batt_temperature_table_num = <17>;
	batt_temperature_table = <
			    (-20) 75022
			    (-15) 57926
			    (-10) 45168
			    (-5) 35548
			    0 28224
			    5 22595
			    10 18231
			    15 14820
			    20 12133
			    25 10000 30 8295 35 6922 40 5810 45 4903 50 4160 55 3547 60 3039>;
	/* t0 -10C */
	battery_profile_t0_num = <104>;
	battery_profile_t0 = <0 4317
				1 	4282
				2 	4261
				3 	4247
				4 	4234
				5 	4222
				7 	4210
				8 	4199
				9 	4188
				10 	4177
				11 	4165
				12 	4155
				13 	4144
				14 	4133
				15 	4123
				16 	4112
				17 	4102
				19 	4092
				20 	4083
				21 	4076
				22 	4070
				23 	4063
				24 	4049
				25 	4031
				26 	4011
				27 	3995
				28 	3981
				29 	3970
				31 	3962
				32 	3955
				33 	3949
				34 	3944
				35 	3936
				36 	3927
				37 	3918
				38 	3907
				39 	3895
				40 	3885
				41 	3877
				42 	3868
				44 	3861
				45 	3855
				46 	3849
				47 	3843
				48 	3838
				49 	3833
				50 	3828
				51 	3824
				52 	3820
				53 	3816
				54 	3811
				56 	3806
				57 	3802
				58 	3799
				59 	3796
				60 	3793
				61 	3790
				62 	3787
				63 	3784
				64 	3782
				65 	3779
				66 	3778
				68 	3776
				69 	3775
				70 	3774
				71 	3772
				72 	3771
				73 	3769
				74 	3767
				75 	3765
				76 	3762
				77 	3758
				78 	3753
				80 	3748
				81 	3741
				82 	3733
				83 	3725
				84 	3714
				85 	3704
				86 	3698
				87 	3695
				88 	3692
				89 	3690
				90 	3688
				91 	3686
				93 	3684
				94 	3680
				95 	3671
				96 	3648
				97 	3607
				98 	3554
				99 	3482
				100 3381
				100 3216
				100 3216
				100 3216
				100 3216
				100 3216
				100 3216
				100 3216
				100 3216
				100 3216
				100 3216
				100 3216>;

	battery_profile_t1_num = <104>;
	battery_profile_t1 = <0	4317
				1 	4282
				2 	4261
				3 	4247
				4 	4234
				5 	4222
				7 	4210
				8 	4199
				9 	4188
				10 	4177
				11 	4165
				12 	4155
				13 	4144
				14 	4133
				15 	4123
				16 	4112
				17 	4102
				19 	4092
				20 	4083
				21 	4076
				22 	4070
				23 	4063
				24 	4049
				25 	4031
				26 	4011
				27 	3995
				28 	3981
				29 	3970
				31 	3962
				32 	3955
				33 	3949
				34 	3944
				35 	3936
				36 	3927
				37 	3918
				38 	3907
				39 	3895
				40 	3885
				41 	3877
				42 	3868
				44 	3861
				45 	3855
				46 	3849
				47 	3843
				48 	3838
				49 	3833
				50 	3828
				51 	3824
				52 	3820
				53 	3816
				54 	3811
				56 	3806
				57 	3802
				58 	3799
				59 	3796
				60 	3793
				61 	3790
				62 	3787
				63 	3784
				64 	3782
				65 	3779
				66 	3778
				68 	3776
				69 	3775
				70 	3774
				71 	3772
				72 	3771
				73 	3769
				74 	3767
				75 	3765
				76 	3762
				77 	3758
				78 	3753
				80 	3748
				81 	3741
				82 	3733
				83 	3725
				84 	3714
				85 	3704
				86 	3698
				87 	3695
				88 	3692
				89 	3690
				90 	3688
				91 	3686
				93 	3684
				94 	3680
				95 	3671
				96 	3648
				97 	3607
				98 	3554
				99 	3482
				100 3381
				100 3216
				100 3216
				100 3216
				100 3216
				100 3216
				100 3216
				100 3216
				100 3216
				100 3216
				100 3216
				100 3216>;
				
	battery_profile_t2_num = <104>;
	battery_profile_t2 = <0	4365
				1 	4352
				2 	4341
				3 	4330
				4 	4319
				5 	4308
				6 	4297
				7 	4285
				8 	4273
				9 	4262
				10 	4250
				11 	4239
				12 	4228
				13 	4217
				14 	4205
				15 	4194
				16 	4182
				17 	4172
				18 	4161
				19 	4150
				20 	4140
				21 	4129
				22 	4118
				23 	4108
				24 	4097
				25 	4086
				26 	4076
				27 	4066
				28 	4058
				29 	4053
				30 	4047
				31 	4034
				32 	4017
				33 	4001
				34 	3987
				35 	3977
				36 	3970
				37 	3966
				38 	3963
				39 	3957
				40 	3949
				41 	3941
				42 	3932
				43 	3923
				44 	3913
				45 	3897
				46 	3884
				47 	3873
				48 	3864
				49 	3857
				50 	3851
				51 	3846
				52 	3840
				53 	3835
				53 	3829
				54 	3825
				55 	3820
				56 	3816
				57 	3812
				58 	3808
				59 	3804
				60 	3799
				61 	3796
				62 	3792
				63 	3789
				64 	3786
				65 	3784
				66 	3781
				67 	3777
				68 	3774
				69 	3772
				70 	3770
				71 	3768
				72 	3765
				73 	3762
				74 	3759
				75 	3755
				76 	3753
				77 	3748
				78 	3745
				79 	3741
				80 	3737
				81 	3733
				82 	3727
				83 	3720
				84 	3712
				85 	3703
				86 	3694
				87 	3685
				88 	3681
				89 	3680
				90 	3679
				91 	3679
				92 	3679
				93 	3677
				94 	3676
				95 	3669
				96 	3647
				97 	3605
				98 	3553
				99 	3485
				100 3395
				100 3254
				100 2948>;
	
	battery_profile_t3_num = <104>;
	battery_profile_t3 = <0	4376
				1 	4363
				2 	4352
				3 	4341
				4 	4331
				5 	4320
				6 	4309
				7 	4298
				8 	4287
				9 	4276
				10 	4264
				11 	4252
				12 	4241
				13 	4230
				14 	4218
				15 	4207
				16 	4196
				17 	4185
				18 	4173
				19 	4162
				20 	4151
				21 	4141
				22 	4130
				23 	4119
				24 	4109
				25 	4098
				26 	4088
				27 	4077
				28 	4067
				29 	4057
				30 	4047
				31 	4038
				32 	4028
				33 	4019
				34 	4010
				35 	4001
				36 	3991
				37 	3983
				38 	3975
				39 	3967
				40 	3959
				41 	3951
				42 	3944
				43 	3936
				44 	3927
				45 	3916
				46 	3900
				47 	3887
				48 	3877
				49 	3869
				50 	3862
				51 	3855
				52 	3849
				53 	3844
				54 	3839
				55 	3834
				56 	3829
				57 	3824
				58 	3820
				59 	3815
				60 	3811
				61 	3806
				62 	3802
				63 	3799
				64 	3795
				65 	3792
				66 	3789
				67 	3786
				67 	3783
				68 	3780
				69 	3777
				70 	3773
				71 	3768
				72 	3760
				73 	3753
				74 	3749
				75 	3745
				76 	3742
				77 	3737
				78 	3732
				79 	3728
				80 	3723
				81 	3718
				82 	3714
				83 	3708
				84 	3699
				85 	3692
				86 	3682
				87 	3672
				88 	3670
				89 	3669
				90 	3669
				91 	3668
				92 	3667
				93 	3666
				94 	3663
				95 	3656
				96 	3629
				97 	3589
				98 	3540
				99 	3473
				100	3380
				100	3239
				100	2946>;

	r_profile_t0_num = <104>;
        r_profile_t0 = <225 	4317 
				283 	4282 
				313 	4261 
				323 	4247 
				328 	4234 
				330 	4222 
				335 	4210 
				335 	4199 
				338 	4188 
				340 	4177 
				340 	4165 
				345 	4155 
				348 	4144 
				350 	4133 
				353 	4123 
				355 	4112 
				360 	4102 
				360 	4092 
				360 	4083 
				372 	4076 
				388 	4070 
				397 	4063 
				390 	4049 
				382 	4031 
				378 	4011 
				373 	3995 
				373 	3981 
				370 	3970 
				370 	3962 
				375 	3955 
				378 	3949 
				388 	3944 
				385 	3936 
				380 	3927 
				375 	3918 
				368 	3907 
				355 	3895 
				350 	3885 
				348 	3877 
				343 	3868 
				345 	3861 
				350 	3855 
				350 	3849 
				350 	3843 
				350 	3838 
				353 	3833 
				353 	3828 
				358 	3824 
				360 	3820 
				363 	3816 
				363 	3811 
				360 	3806 
				363 	3802 
				363 	3799 
				368 	3796 
				368 	3793 
				370 	3790 
				375 	3787 
				375 	3784 
				378 	3782 
				378 	3779 
				383 	3778 
				383 	3776 
				388 	3775 
				388 	3774 
				388 	3772 
				393 	3771 
				395 	3769 
				400 	3767 
				405 	3765 
				410 	3762 
				418 	3758 
				428 	3753 
				435 	3748 
				450 	3741 
				463 	3733 
				473 	3725 
				485 	3714 
				495 	3704 
				515 	3698 
				528 	3695 
				548 	3692 
				573 	3690 
				593 	3688 
				623 	3686 
				663 	3684 
				700 	3680 
				745 	3671 
				770 	3648 
				808 	3607 
				863 	3554 
				935 	3482 
				1035 	3381 
				1255 	3216 
				1255 	3216 
				1255 	3216 
				1255 	3216 
				1255 	3216 
				1255 	3216 
				1255 	3216 
				1255 	3216 
				1255 	3216 
				1255 	3216 
				1255 	3216>;

	r_profile_t1_num = <104>;
        r_profile_t1 = <225 	4317 
				283 	4282 
				313 	4261 
				323 	4247 
				328 	4234 
				330 	4222 
				335 	4210 
				335 	4199 
				338 	4188 
				340 	4177 
				340 	4165 
				345 	4155 
				348 	4144 
				350 	4133 
				353 	4123 
				355 	4112 
				360 	4102 
				360 	4092 
				360 	4083 
				372 	4076 
				388 	4070 
				397 	4063 
				390 	4049 
				382 	4031 
				378 	4011 
				373 	3995 
				373 	3981 
				370 	3970 
				370 	3962 
				375 	3955 
				378 	3949 
				388 	3944 
				385 	3936 
				380 	3927 
				375 	3918 
				368 	3907 
				355 	3895 
				350 	3885 
				348 	3877 
				343 	3868 
				345 	3861 
				350 	3855 
				350 	3849 
				350 	3843 
				350 	3838 
				353 	3833 
				353 	3828 
				358 	3824 
				360 	3820 
				363 	3816 
				363 	3811 
				360 	3806 
				363 	3802 
				363 	3799 
				368 	3796 
				368 	3793 
				370 	3790 
				375 	3787 
				375 	3784 
				378 	3782 
				378 	3779 
				383 	3778 
				383 	3776 
				388 	3775 
				388 	3774 
				388 	3772 
				393 	3771 
				395 	3769 
				400 	3767 
				405 	3765 
				410 	3762 
				418 	3758 
				428 	3753 
				435 	3748 
				450 	3741 
				463 	3733 
				473 	3725 
				485 	3714 
				495 	3704 
				515 	3698 
				528 	3695 
				548 	3692 
				573 	3690 
				593 	3688 
				623 	3686 
				663 	3684 
				700 	3680 
				745 	3671 
				770 	3648 
				808 	3607 
				863 	3554 
				935 	3482 
				1035 	3381 
				1255 	3216 
				1255 	3216 
				1255 	3216 
				1255 	3216 
				1255 	3216 
				1255 	3216 
				1255 	3216 
				1255 	3216 
				1255 	3216 
				1255 	3216 
				1255 	3216>;

	r_profile_t2_num = <104>;
        r_profile_t2 = <138 	4365 
				110 	4352 
				113 	4341 
				113 	4330 
				115 	4319 
				115 	4308 
				115 	4297 
				117 	4285 
				117 	4273 
				119 	4262 
				117 	4250 
				119 	4239 
				119 	4228 
				121 	4217 
				119 	4205 
				121 	4194 
				121 	4182 
				124 	4172 
				124 	4161 
				124 	4150 
				126 	4140 
				126 	4129 
				128 	4118 
				132 	4108 
				130 	4097 
				132 	4086 
				132 	4076 
				132 	4066 
				135 	4058 
				143 	4053 
				146 	4047 
				141 	4034 
				139 	4017 
				137 	4001 
				135 	3987 
				139 	3977 
				141 	3970 
				143 	3966 
				148 	3963 
				143 	3957 
				146 	3949 
				146 	3941 
				148 	3932 
				148 	3923 
				146 	3913 
				128 	3897 
				119 	3884 
				113 	3873 
				113 	3864 
				110 	3857 
				110 	3851 
				113 	3846 
				110 	3840 
				110 	3835 
				108 	3829 
				113 	3825 
				110 	3820 
				117 	3816 
				119 	3812 
				119 	3808 
				119 	3804 
				117 	3799 
				119 	3796 
				119 	3792 
				119 	3789 
				121 	3786 
				124 	3784 
				121 	3781 
				119 	3777 
				119 	3774 
				121 	3772 
				121 	3770 
				124 	3768 
				121 	3765 
				121 	3762 
				119 	3759 
				117 	3755 
				121 	3753 
				115 	3748 
				117 	3745 
				117 	3741 
				117 	3737 
				119 	3733 
				119 	3727 
				119 	3720 
				124 	3712 
				121 	3703 
				121 	3694 
				119 	3685 
				117 	3681 
				119 	3680 
				124 	3679 
				128 	3679 
				135 	3679 
				139 	3677 
				146 	3676 
				146 	3669 
				139 	3647 
				139 	3605 
				146 	3553 
				155 	3485 
				172 	3395 
				212 	3254 
				519 	2948>;

	r_profile_t3_num = <104>;
        r_profile_t3 = <110 	4376 
				90 	4363 
				90 	4352 
				90 	4341 
				90 	4331 
				90 	4320 
				90 	4309 
				93 	4298 
				93 	4287 
				93 	4276 
				93 	4264 
				90 	4252 
				93 	4241 
				95 	4230 
				93 	4218 
				95 	4207 
				98 	4196 
				98 	4185 
				95 	4173 
				95 	4162 
				98 	4151 
				100 	4141 
				100 	4130 
				100 	4119 
				100 	4109 
				105 	4098 
				100 	4088 
				103 	4077 
				105 	4067 
				105 	4057 
				105 	4047 
				105 	4038 
				105 	4028 
				108 	4019 
				108 	4010 
				110 	4001 
				108 	3991 
				110 	3983 
				113 	3975 
				115 	3967 
				115 	3959 
				118 	3951 
				123 	3944 
				123 	3936 
				125 	3927 
				120 	3916 
				108 	3900 
				100 	3887 
				95 	3877 
				95 	3869 
				95 	3862 
				90 	3855 
				93 	3849 
				93 	3844 
				98 	3839 
				98 	3834 
				98 	3829 
				98 	3824 
				100 	3820 
				100 	3815 
				100 	3811 
				98 	3806 
				100 	3802 
				103 	3799 
				103 	3795 
				103 	3792 
				105 	3789 
				108 	3786 
				108 	3783 
				108 	3780 
				108 	3777 
				105 	3773 
				100 	3768 
				95 	3760 
				98 	3753 
				100 	3749 
				100 	3745 
				100 	3742 
				100 	3737 
				98 	3732 
				98 	3728 
				95 	3723 
				93 	3718 
				95 	3714 
				95 	3708 
				93 	3699 
				95 	3692 
				93 	3682 
				93 	3672 
				93 	3670 
				95 	3669 
				98 	3669 
				100 	3668 
				100 	3667 
				103 	3666 
				103 	3663 
				103 	3656 
				100 	3629 
				105 	3589 
				110 	3540 
				113 	3473 
				115 	3380 
				135 	3239 
				335 	2946>;
};
