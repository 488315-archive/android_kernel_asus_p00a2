/*************************
 * Customized Battery Setting dtsi file
*************************/
&bat_comm_1 {
	/* cust_charging.h */
	/* stop charging while in talking mode */
	stop_charging_in_takling = <1>;
	talking_recharge_voltage = <3800>;
	talking_sync_time = <60>;

	/* Battery Temperature Protection */
	mtk_temperature_recharge_support = <1>;
	max_charge_temperature = <50>;
	max_charge_temperature_minus_x_degree = <47>;
	min_charge_temperature = <0>;
	min_charge_temperature_plus_x_degree = <6>;
	err_charge_temperature = <0xff>;

	/* Linear Charging Threshold */
	v_pre2cc_thres = <3400>;	/* unit: mV */
	v_cc2topoff_thres = <4050>;
	recharging_voltage = <4110>;
	charging_full_current = <100>;	/* unit: mA */

	/* Charging Current Setting */
	config_usb_if = <0>;
	usb_charger_current_suspend = <0>;	/* Unit: 0.01 mA */
	usb_charger_current_unconfigured = <7000>;	/* Unit: 0.01 mA */
	usb_charger_current_configured = <50000>;	/* Unit: 0.01 mA */
	usb_charger_current = <50000>;	/* Unit: 0.01 mA */
	ac_charger_current = <200000>;	/* Unit: 0.01 mA */
	non_std_ac_charger_current = <50000>;	/* Unit: 0.01 mA */
	charging_host_charger_current = <65000>;	/* Unit: 0.01 mA */
	apple_0_5a_charger_current = <50000>;	/* Unit: 0.01 mA */
	apple_1_0a_charger_current = <65000>;	/* Unit: 0.01 mA */
	apple_2_1a_charger_current = <80000>;	/* Unit: 0.01 mA */

	/* charger error check */
	bat_low_temp_protect_enable = <0>;
	v_charger_enable = <0>;	/* 1:on , 0:off */
	v_charger_max = <6500>;	/* unit: mV */
	v_charger_min = <4400>;

	/*  Tracking TIME */
	onehundred_percent_tracking_time = <10>;	/* Unit: second */
	npercent_tracking_time = <20>;	/* Unit: second */
	sync_to_real_tracking_time = <60>;	/* Unit: second */
	v_0percent_tracking = <3450>;	/* Unit: mV */

	/* High battery support */
	high_battery_voltage_support = <1>;
};

&bat_meter_1 {
	/* cust_battery_meter.h */
	/* ADC resistor  */
	r_bat_sense = <4>;
	r_i_sense = <4>;
	r_charger_1 = <330>;
	r_charger_2 = <39>;
	temperature_t0 = <110>;
	temperature_t1 = <0>;
	temperature_t2 = <25>;
	temperature_t3 = <50>;
	temperature_t = <255>;	/* this should be fixed, never change the value */
	fg_meter_resistance = <0>;

	/* Qmax for 0mA */
	q_max_pos_50 = <4615>;/*<3009>;*/
	q_max_pos_25 = <4591>;/*<3009>;*/
	q_max_pos_0 = <4199>;/*<3009>;*/
	q_max_neg_10 = <4199>;/*<3009>;*/
	/* Qmax for 400mA, said high current */
	q_max_pos_50_h_current = <4596>;/*<2975>;*/
	q_max_pos_25_h_current = <4563>;/*<2975>;*/
	q_max_pos_0_h_current = <3794>;/*<2975>;*/
	q_max_neg_10_h_current = <3794>;/*<2975>;*/
	/* Discharge percentage, 1: D5, 0: D2 */
	oam_d5 = <0>;

	change_tracking_point = <1>;
	/* SW OCV tracking setting */
	cust_tracking_point = <14>;
	cust_r_sense = <200>;
	cust_hw_cc = <0>;
	aging_tuning_value = <100>;
	cust_r_fg_offset = <0>;
	ocv_board_compesate = <0>;
	r_fg_board_base = <1000>;
	r_fg_board_slope = <1000>;
	car_tune_value = <89>;

	/* HW Fuel gague  */
	current_detect_r_fg = <10>;	/* Unit: mA */
	minerroroffset = <1000>;
	fg_vbat_average_size = <18>;
	r_fg_value = <0>;	/* Unit: mOhm */

	cust_poweron_delta_capacity_tolrance = <80>;
	cust_poweron_low_capacity_tolrance = <2>;
	cust_poweron_max_vbat_tolrance = <70>;
	cust_poweron_delta_vbat_tolrance = <60>;
	cust_poweron_delta_hw_sw_ocv_capacity_tolrance = <10>;

	/* Fixed battery temperature */
	fixed_tbat_25 = <0>;
	/* Dynamic change wake up period of battery thread when suspend */
	vbat_normal_wakeup = <3600>;	/* Unit: mV */
	vbat_low_power_wakeup = <3500>;	/* Unit: mV */
	normal_wakeup_period = <5400>;	/* Unit: second */
	low_power_wakeup_period = <300>;	/* Unit: second */
	close_poweroff_wakeup_period = <30>;	/* Unit: second */

	rbat_pull_up_r = <16900>;
	rbat_pull_up_volt = <1800>;

	batt_temperature_table_num = <17>;
	batt_temperature_table = <
			    (-20) 75022
			    (-15) 57926
			    (-10) 45168
			    (-5) 35548
			    0 28224
			    5 22595
			    10 18231
			    15 14820
			    20 12133
			    25 10000 30 8295 35 6922 40 5810 45 4903 50 4160 55 3547 60 3039>;
	/* t0 -10C */
	battery_profile_t0_num = <105>;
	battery_profile_t0 = <0	4325
				1 	4287
				2 	4256
				3 	4235
				4 	4219
				5 	4205
				6 	4193
				8 	4182
				9 	4172
				10 	4160
				11 	4149
				12 	4138
				13 	4128
				14 	4117
				15 	4107
				16 	4097
				17 	4089
				18 	4083
				19 	4077
				20 	4070
				21 	4059
				23 	4042
				24 	4019
				25 	4000
				26 	3985
				27 	3975
				28 	3966
				29 	3959
				30 	3953
				31 	3948
				32 	3942
				33 	3937
				34 	3932
				35 	3925
				36 	3916
				38 	3906
				39 	3895
				40 	3885
				41 	3875
				42 	3867
				43 	3860
				44 	3854
				45 	3848
				46 	3842
				47 	3837
				48 	3832
				49 	3828
				50 	3823
				52 	3819
				53 	3814
				54 	3810
				55 	3807
				56 	3803
				57 	3800
				58 	3796
				59 	3793
				60 	3790
				61 	3787
				62 	3785
				63 	3783
				64 	3781
				65 	3780
				67 	3778
				68 	3777
				69 	3776
				70 	3774
				71 	3773
				72 	3771
				73 	3768
				74 	3765
				75 	3762
				76 	3759
				77 	3756
				78 	3752
				79 	3748
				80 	3743
				82 	3738
				83 	3732
				84 	3725
				85 	3719
				86 	3712
				87 	3705
				88 	3699
				89 	3695
				90 	3693
				91 	3690
				92 	3688
				93 	3684
				94 	3678
				95 	3664
				97 	3635
				98 	3591
				99 	3526
				100 3432
				100 3263
				100 3263
				100 3263
				100 3263
				100 3263
				100 3263
				100 3263
				100 3263
				100 3263
				100 3263
				100 3263>;

	battery_profile_t1_num = <105>;
	battery_profile_t1 = <0	4325
				1 	4287
				2 	4256
				3 	4235
				4 	4219
				5 	4205
				6 	4193
				8 	4182
				9 	4172
				10 	4160
				11 	4149
				12 	4138
				13 	4128
				14 	4117
				15 	4107
				16 	4097
				17 	4089
				18 	4083
				19 	4077
				20 	4070
				21 	4059
				23 	4042
				24 	4019
				25 	4000
				26 	3985
				27 	3975
				28 	3966
				29 	3959
				30 	3953
				31 	3948
				32 	3942
				33 	3937
				34 	3932
				35 	3925
				36 	3916
				38 	3906
				39 	3895
				40 	3885
				41 	3875
				42 	3867
				43 	3860
				44 	3854
				45 	3848
				46 	3842
				47 	3837
				48 	3832
				49 	3828
				50 	3823
				52 	3819
				53 	3814
				54 	3810
				55 	3807
				56 	3803
				57 	3800
				58 	3796
				59 	3793
				60 	3790
				61 	3787
				62 	3785
				63 	3783
				64 	3781
				65 	3780
				67 	3778
				68 	3777
				69 	3776
				70 	3774
				71 	3773
				72 	3771
				73 	3768
				74 	3765
				75 	3762
				76 	3759
				77 	3756
				78 	3752
				79 	3748
				80 	3743
				82 	3738
				83 	3732
				84 	3725
				85 	3719
				86 	3712
				87 	3705
				88 	3699
				89 	3695
				90 	3693
				91 	3690
				92 	3688
				93 	3684
				94 	3678
				95 	3664
				97 	3635
				98 	3591
				99 	3526
				100 3432
				100 3263
				100 3263
				100 3263
				100 3263
				100 3263
				100 3263
				100 3263
				100 3263
				100 3263
				100 3263
				100 3263>;
				
	battery_profile_t2_num = <105>;
	battery_profile_t2 = <0	4341 
				1 	4326 
				2 	4312 
				3 	4300 
				4 	4284 
				5 	4275 
				6 	4264 
				7 	4253 
				8 	4241 
				9 	4231 
				10 	4221 
				11 	4210 
				12 	4196 
				13 	4188 
				14 	4178 
				15 	4167 
				16 	4156 
				17 	4147 
				18 	4137 
				19 	4126 
				20 	4112 
				21 	4105 
				22 	4095 
				23 	4085 
				24 	4074 
				25 	4068 
				26 	4065 
				27 	4059 
				28 	4046 
				29 	4031 
				29 	4012 
				30 	3996 
				31 	3984 
				32 	3976 
				33 	3970 
				34 	3964 
				35 	3957 
				36 	3958 
				37 	3954 
				38 	3947 
				39 	3939 
				40 	3932 
				41 	3924 
				42 	3914 
				43 	3900 
				44 	3889 
				45 	3877 
				46 	3868 
				47 	3861 
				48 	3855 
				49 	3849 
				50 	3844 
				51 	3836 
				52 	3834 
				53 	3829 
				54 	3825 
				55 	3821 
				56 	3817 
				57 	3813 
				58 	3810 
				59 	3804 
				60 	3803 
				61 	3800 
				62 	3797 
				63 	3793 
				64 	3790 
				65 	3787 
				66 	3785 
				67 	3780 
				68 	3780 
				69 	3778 
				70 	3775 
				71 	3773 
				72 	3769 
				73 	3766 
				74 	3762 
				75 	3757 
				76 	3756 
				77 	3752 
				78 	3748 
				79 	3745 
				80 	3741 
				81 	3739 
				82 	3736 
				83 	3730 
				84 	3726 
				85 	3719 
				86 	3712 
				87 	3707 
				87 	3700 
				88 	3691 
				89 	3687 
				90 	3685 
				91 	3684 
				92 	3683 
				93 	3681 
				94 	3679 
				95 	3674 
				96 	3655 
				97 	3612 
				98 	3556 
				99 	3482 
				100	3366 
				100	3096 
				100	3096>;
				
	battery_profile_t3_num = <105>;
	battery_profile_t3 = <0	4366 
				1 	4350 
				2 	4335 
				3 	4322 
				4 	4310 
				5 	4298 
				6 	4286 
				7 	4274 
				8 	4263 
				9 	4251 
				10 	4240 
				11 	4229 
				12 	4218 
				13 	4207 
				14 	4196 
				15 	4185 
				16 	4174 
				17 	4163 
				18 	4152 
				19 	4142 
				20 	4131 
				21 	4121 
				22 	4111 
				22 	4101 
				23 	4091 
				24 	4081 
				25 	4070 
				26 	4061 
				27 	4051 
				28 	4042 
				29 	4035 
				30 	4024 
				31 	4012 
				32 	4002 
				33 	3996 
				34 	3989 
				35 	3981 
				36 	3973 
				37 	3966 
				38 	3958 
				39 	3951 
				40 	3943 
				41 	3936 
				42 	3929 
				43 	3921 
				44 	3910 
				45 	3896 
				46 	3882 
				47 	3873 
				48 	3865 
				49 	3859 
				50 	3853 
				51 	3847 
				52 	3842 
				53 	3837 
				54 	3832 
				55 	3827 
				56 	3823 
				57 	3818 
				58 	3813 
				59 	3809 
				60 	3806 
				61 	3802 
				62 	3799 
				63 	3796 
				64 	3792 
				64 	3790 
				65 	3787 
				66 	3784 
				67 	3781 
				68 	3779 
				69 	3776 
				70 	3774 
				71 	3770 
				72 	3765 
				73 	3757 
				74 	3750 
				75 	3745 
				76 	3742 
				77 	3737 
				78 	3733 
				79 	3728 
				80 	3724 
				81 	3721 
				82 	3718 
				83 	3714 
				84 	3709 
				85 	3703 
				86 	3697 
				87 	3692 
				88 	3685 
				89 	3676 
				90 	3673 
				91 	3672 
				92 	3671 
				93 	3670 
				94 	3669 
				95 	3665 
				96 	3657 
				97 	3627 
				98 	3583 
				99 	3525 
				100 3445 
				100 3320 
				100 3027>;

	r_profile_t0_num = <105>;
        r_profile_t0 = <225	4325
				241	4287
				289	4256
				316	4235
				327	4219
				336	4205
				340	4193
				342	4182
				349	4172
				349	4160
				351	4149
				351	4138
				355	4128
				355	4117
				358	4107
				340	4097
				364	4089
				377	4083
				386	4077
				391	4070
				391	4059
				377	4042
				366	4019
				362	4000
				360	3985
				360	3975
				362	3966
				364	3959
				369	3953
				371	3948
				373	3942
				377	3937
				377	3932
				373	3925
				366	3916
				358	3906
				349	3895
				344	3885
				338	3875
				336	3867
				333	3860
				333	3854
				333	3848
				333	3842
				336	3837
				336	3832
				340	3828
				340	3823
				342	3819
				340	3814
				340	3810
				344	3807
				344	3803
				347	3800
				347	3796
				349	3793
				351	3790
				351	3787
				355	3785
				358	3783
				360	3781
				369	3780
				371	3778
				380	3777
				389	3776
				395	3774
				404	3773
				415	3771
				422	3768
				433	3765
				444	3762
				457	3759
				470	3756
				481	3752
				494	3748
				508	3743
				521	3738
				532	3732
				541	3725
				554	3719
				565	3712
				578	3705
				594	3699
				614	3695
				640	3693
				664	3690
				695	3688
				726	3684
				764	3678
				797	3664
				826	3635
				861	3591
				916	3526
				1007	3432
				1238	3263
				1238	3263
				1238	3263
				1238	3263
				1238	3263
				1238	3263
				1238	3263
				1238	3263
				1238	3263
				1238	3263
				1238	3263>;

	r_profile_t1_num = <105>;
        r_profile_t1 = <225	4325
				241	4287
				289	4256
				316	4235
				327	4219
				336	4205
				340	4193
				342	4182
				349	4172
				349	4160
				351	4149
				351	4138
				355	4128
				355	4117
				358	4107
				340	4097
				364	4089
				377	4083
				386	4077
				391	4070
				391	4059
				377	4042
				366	4019
				362	4000
				360	3985
				360	3975
				362	3966
				364	3959
				369	3953
				371	3948
				373	3942
				377	3937
				377	3932
				373	3925
				366	3916
				358	3906
				349	3895
				344	3885
				338	3875
				336	3867
				333	3860
				333	3854
				333	3848
				333	3842
				336	3837
				336	3832
				340	3828
				340	3823
				342	3819
				340	3814
				340	3810
				344	3807
				344	3803
				347	3800
				347	3796
				349	3793
				351	3790
				351	3787
				355	3785
				358	3783
				360	3781
				369	3780
				371	3778
				380	3777
				389	3776
				395	3774
				404	3773
				415	3771
				422	3768
				433	3765
				444	3762
				457	3759
				470	3756
				481	3752
				494	3748
				508	3743
				521	3738
				532	3732
				541	3725
				554	3719
				565	3712
				578	3705
				594	3699
				614	3695
				640	3693
				664	3690
				695	3688
				726	3684
				764	3678
				797	3664
				826	3635
				861	3591
				916	3526
				1007	3432
				1238	3263
				1238	3263
				1238	3263
				1238	3263
				1238	3263
				1238	3263
				1238	3263
				1238	3263
				1238	3263
				1238	3263
				1238	3263>;

		r_profile_t2_num = <105>;
        r_profile_t2 = <138 4341 
				124 4326 
				124 4312 
				126 4300 
				117	4284 
				126	4275 
				124	4264 
				126	4253 
				124	4241 
				126	4231 
				128	4221 
				126	4210 
				119	4196 
				130	4188 
				128	4178 
				128	4167 
				126	4156 
				132	4147 
				132	4137 
				130	4126 
				126	4112 
				137	4105 
				135	4095 
				137	4085 
				132	4074 
				139	4068 
				148	4065 
				148	4059 
				141	4046 
				143	4031 
				139	4012 
				137	3996 
				137	3984 
				143	3976 
				146	3970 
				146	3964 
				143	3957 
				157	3958 
				155	3954 
				152	3947 
				152	3939 
				155	3932 
				155	3924 
				152	3914 
				141	3900 
				141	3889 
				130	3877 
				126	3868 
				124	3861 
				126	3855 
				124	3849 
				124	3844 
				117	3836 
				128	3834 
				126	3829 
				126	3825 
				126	3821 
				126	3817 
				126	3813 
				128	3810 
				124	3804 
				130	3803 
				130	3800 
				130	3797 
				128	3793 
				128	3790 
				128	3787 
				130	3785 
				124	3780 
				132	3780 
				130	3778 
				130	3775 
				130	3773 
				126	3769 
				126	3766 
				126	3762 
				121	3757 
				128	3756 
				124	3752 
				124	3748 
				126	3745 
				124	3741 
				126	3739 
				128	3736 
				124	3730 
				128	3726 
				124	3719 
				124	3712 
				124	3707 
				124	3700 
				126	3691 
				126	3687 
				128	3685 
				128	3684 
				132	3683 
				132	3681 
				135	3679 
				141	3674 
				139	3655 
				137	3612 
				141	3556 
				155	3482 
				168	3366 
				799	3096 
				799	3096>;

	r_profile_t3_num = <105>;
        r_profile_t3 = <110	4366 
				95 	4350 
				93 	4335 
				91 	4322 
				95 	4310 
				95 	4298 
				93 	4286 
				93 	4274 
				93 	4263 
				93 	4251 
				93 	4240 
				95 	4229 
				95 	4218 
				95 	4207 
				95 	4196 
				95 	4185 
				95 	4174 
				93 	4163 
				93 	4152 
				97 	4142 
				95 	4131 
				97 	4121 
				97 	4111 
				97 	4101 
				97 	4091 
				97 	4081 
				95 	4070 
				99 	4061 
				97 	4051 
				99 	4042 
				104 	4035 
				99 	4024 
				99 	4012 
				102 	4002 
				104 	3996 
				102 	3989 
				104 	3981 
				104 	3973 
				106 	3966 
				106 	3958 
				108 	3951 
				108 	3943 
				110 	3936 
				113 	3929 
				115 	3921 
				110 	3910 
				104 	3896 
				97 	3882 
				95 	3873 
				93 	3865 
				95 	3859 
				95 	3853 
				93 	3847 
				93 	3842 
				95 	3837 
				93 	3832 
				93 	3827 
				95 	3823 
				93 	3818 
				93 	3813 
				93 	3809 
				95 	3806 
				95 	3802 
				97 	3799 
				97 	3796 
				95 	3792 
				99 	3790 
				99 	3787 
				99 	3784 
				99 	3781 
				102 	3779 
				102 	3776 
				104 	3774 
				102 	3770 
				97 	3765 
				93 	3757 
				93 	3750 
				93 	3745 
				95 	3742 
				93 	3737 
				93 	3733 
				93 	3728 
				93 	3724 
				93 	3721 
				95 	3718 
				95 	3714 
				95 	3709 
				95 	3703 
				95 	3697 
				97 	3692 
				97 	3685 
				93 	3676 
				93 	3673 
				95 	3672 
				95 	3671 
				97 	3670 
				99 	3669 
				99 	3665 
				102 	3657 
				97 	3627 
				99 	3583 
				104 	3525 
				110 	3445 
				124 	3320 
				841 	3027>;
};
